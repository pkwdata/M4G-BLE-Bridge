## Kconfig
```kconfig
mainmenu "Espressif IoT Development Framework Configuration"

source "$IDF_PATH/Kconfig"

menu "M4G Bridge Options"

# Include settings component Kconfig first for easy access
rsource "components/m4g_settings/Kconfig"

menu "Split Keyboard Configuration"
	comment "Configure for split keyboard setup with 2.4GHz wireless connection"

	choice M4G_SPLIT_ROLE
		prompt "Device Role"
		default M4G_SPLIT_ROLE_LEFT
		help
			Select the role of this device in a split keyboard configuration.
			LEFT: Connects to left keyboard via USB, receives data from right side via ESP-NOW, and transmits to computer via BLE
			RIGHT: Connects to right keyboard via USB and transmits data to left side via ESP-NOW
			STANDALONE: Single keyboard setup (original behavior, no ESP-NOW)

	config M4G_SPLIT_ROLE_LEFT
		bool "Left Side (USB + ESP-NOW RX + BLE)"
		help
			Build firmware for the left-side board.
			- Connects to left keyboard half via USB
			- Receives right keyboard data via ESP-NOW (2.4GHz)
			- Combines both sides and transmits to computer via Bluetooth

	config M4G_SPLIT_ROLE_RIGHT
		bool "Right Side (USB + ESP-NOW TX)"
		help
			Build firmware for the right-side board.
			- Connects to right keyboard half via USB
			- Transmits keyboard data to left side via ESP-NOW (2.4GHz)
			- No Bluetooth functionality (acts as wireless USB bridge)

	config M4G_SPLIT_ROLE_STANDALONE
		bool "Standalone (Original Single Keyboard)"
		help
			Build firmware for single keyboard setup (original behavior).
			- Connects to one keyboard via USB
			- Transmits to computer via Bluetooth
			- No ESP-NOW functionality
	endchoice

	config M4G_ESPNOW_CHANNEL
		int "ESP-NOW WiFi Channel"
		range 1 13
		default 1
		depends on !M4G_SPLIT_ROLE_STANDALONE
		help
			WiFi channel for ESP-NOW communication between left and right boards.
			Both boards must use the same channel.

	config M4G_ESPNOW_USE_ENCRYPTION
		bool "Enable ESP-NOW Encryption"
		default y
		depends on !M4G_SPLIT_ROLE_STANDALONE
		help
			Enable encrypted ESP-NOW communication between boards.
			Both boards must use the same PMK (Primary Master Key).

	config M4G_ESPNOW_PMK
		string "ESP-NOW Primary Master Key (16 chars)"
		default "M4G_SPLIT_KEY!!"
		depends on M4G_ESPNOW_USE_ENCRYPTION
		help
			16-character Primary Master Key for encrypted ESP-NOW communication.
			Change this to a unique value for security.
			Both left and right boards must use the same key.
endmenu

menu "Platform Configuration"
	comment "Platform selection determines USB host controller and BLE stack"

	choice M4G_TARGET
		prompt "Target Platform"
		default M4G_TARGET_ESP32S3
		help
			Select the target platform for the M4G BLE Bridge.
			This determines the USB host controller and BLE stack used.

	config M4G_TARGET_ESP32S3
		bool "ESP32-S3 (native USB host)"
		help
			Build for ESP32-S3 with native USB OTG host capabilities.
			Supports dual-device CharaChorder and standard keyboards.
			Uses ESP-IDF USB host stack and NimBLE.

	config M4G_TARGET_NRF52840
		bool "nRF52840 + MAX3421E (experimental)"
		help
			Build for nRF52840 SoC with external MAX3421E USB host controller.
			Requires custom hardware with MAX3421E connected via SPI.
			Uses Zephyr RTOS and Zephyr BLE stack.
			WARNING: This is experimental and not yet fully implemented.
	endchoice

	menu "nRF52840 + MAX3421E Configuration"
		depends on M4G_TARGET_NRF52840

		config M4G_MAX_DEVICES
			int "Max simultaneous USB devices"
			range 1 4
			default 2
			help
				Maximum number of USB HID devices that can be connected simultaneously.

		config M4G_MAX3421E_SPI_FREQ
			int "MAX3421E SPI frequency (Hz)"
			range 1000000 16000000
			default 8000000
			help
				SPI clock frequency for communication with MAX3421E.
				Higher frequencies may improve performance but check signal integrity.

		config M4G_MAX3421E_INT_GPIO
			int "MAX3421E interrupt GPIO"
			range 0 47
			default 3
			help
				GPIO pin connected to MAX3421E INT output.

		config M4G_MAX3421E_CS_GPIO
			int "MAX3421E chip select GPIO"
			range 0 47
			default 4
			help
				GPIO pin for MAX3421E SPI chip select.

		config M4G_MAX3421E_RESET_GPIO
			int "MAX3421E reset GPIO (-1 to disable)"
			range -1 47
			default -1
			help
				GPIO pin connected to MAX3421E reset input. Set to -1 if not connected.

		config M4G_NRF52840_SPI_INSTANCE
			int "SPI instance (0, 1, or 2)"
			range 0 2
			default 0
			help
				nRF52840 SPI instance to use for MAX3421E communication.
	endmenu
endmenu

config M4G_ENABLE_ARROW_MOUSE
	bool "Enable arrow keys -> mouse movement mapping"
	default y
	help
		When enabled, the bridge will translate arrow keys into relative mouse
		movements. Disable to pass arrow keys through unchanged.

menu "Mouse Movement Configuration"
	depends on M4G_ENABLE_ARROW_MOUSE

	config M4G_MOUSE_BASE_SPEED
		int "Base mouse movement speed (pixels)"
		range 1 50
		default 6
		help
			Initial movement speed in pixels when arrow key is first pressed.
			This is the starting speed before acceleration kicks in.

	config M4G_MOUSE_ENABLE_ACCELERATION
		bool "Enable mouse acceleration"
		default y
		help
			When enabled, mouse movement speed increases the longer the arrow
			key is held down, providing finer control for small movements and
			faster traversal for longer movements.

	config M4G_MOUSE_ACCEL_INCREMENT
		int "Mouse acceleration increment (pixels)"
		depends on M4G_MOUSE_ENABLE_ACCELERATION
		range 1 10
		default 2
		help
			Amount to increase speed for every acceleration step when key is held.
			Speed increases by this amount every ACCEL_INTERVAL_MS milliseconds.

	config M4G_MOUSE_ACCEL_INTERVAL_MS
		int "Mouse acceleration interval (ms)"
		depends on M4G_MOUSE_ENABLE_ACCELERATION
		range 50 1000
		default 75
		help
			Time interval in milliseconds between acceleration steps.
			Every 75ms the key is held, speed increases by ACCEL_INCREMENT pixels.

	config M4G_MOUSE_MAX_SPEED
		int "Maximum mouse speed (pixels)"
		depends on M4G_MOUSE_ENABLE_ACCELERATION
		range 5 100
		default 40
		help
			Maximum movement speed in pixels, regardless of how long the key
			is held. Prevents overly fast cursor movement.
endmenu

config M4G_ENABLE_DUPLICATE_SUPPRESSION
	bool "Suppress duplicate consecutive HID reports"
	default y
	help
		When enabled, identical consecutive keyboard/mouse reports will not be
		re-sent over BLE to reduce bandwidth and power consumption.

menu "Key Repeat Configuration"
	config M4G_ENABLE_KEY_REPEAT
		bool "Enable key repeat for held keys"
		default y
		help
			When enabled, holding down a key will cause it to repeat after an
			initial delay, similar to standard keyboard behavior.

	config M4G_KEY_REPEAT_DELAY_MS
		int "Key repeat initial delay (ms)"
		depends on M4G_ENABLE_KEY_REPEAT
		range 100 5000
		default 1000
		help
			Time in milliseconds to wait before starting key repeat when a key
			is held down. This delay starts AFTER the chord timeout period.
			
			Typing speed considerations:
			- Fast typists (90 WPM): ~133ms per character
			- Slow typists (15 WPM): ~800ms per character
			- Typical single keypress: 50-200ms hold time
			- Deliberate key hold for repeat: >500ms
			
			Recommended: 500-1000ms to avoid accidental repeats while typing
			normally, but allow intentional repeat without excessive delay.
			Total delay = chord_timeout (500ms) + this value (1000ms) = ~1500ms

	config M4G_KEY_REPEAT_RATE_MS
		int "Key repeat rate (ms)"
		depends on M4G_ENABLE_KEY_REPEAT
		range 10 500
		default 33
		help
			Time interval in milliseconds between repeated keypresses once
			repeat has started. 33ms = ~30 repetitions per second.
			Standard keyboard behavior is typically 30-50ms.
endmenu

menu "CharaChorder Configuration"
	config M4G_CHARACHORDER_CHORD_TIMEOUT_MS
		int "Single-key chord timeout (ms)"
		range 50 1000
		default 500
		help
			Time in milliseconds to wait for a second key when chord collection
			starts with a single key. If no second key arrives within this timeout,
			the single key is passed through for normal processing (including key repeat).
			Lower values allow faster key repeat, higher values allow more time for
			chord detection. Typical chords are pressed within 50-150ms.
			Recommended: 100-200ms for comfortable chord detection.

	config M4G_CHARACHORDER_CHORD_DELAY_MS
		int "CharaChorder chord processing grace period (ms)"
		range 5 500
		default 15
		help
			Grace period in milliseconds that the bridge waits for chord output after
			physical keys are released. This allows the CharaChorder firmware to emit
			expanded text before the bridge falls back to single-key replay.

	config M4G_CHARACHORDER_REQUIRE_BOTH_HALVES
		bool "Require both CharaChorder halves for connection"
		default y
		help
			When enabled, the USB side is only considered "connected" when both
			CharaChorder halves have been detected.

	config M4G_CHARACHORDER_RAW_MODE
		bool "CharaChorder raw passthrough (disable chord buffering)"
		default n
		help
			Skip chord buffering and forward raw key reports immediately. Useful for
			debugging or specialized workflows where the host should see raw finger
			positions.
endmenu

config M4G_LOG_PERSISTENCE
	bool "Persist logs to NVS"
	default y if M4G_BOARD_QTPY
	default n if M4G_BOARD_DEVKIT
	help
		Controls whether logs are appended to an NVS blob for retrieval on next boot.
		Default: enabled for QT Py board, disabled for DevKit.

config M4G_ASSERT_BLE_HANDLE
	bool "Assert BLE report handle resolved"
	default y
	help
		If enabled, sending a report before the characteristic handle is resolved
		triggers an assert (development aid). Disable in production builds.

config M4G_CLEAR_BONDING_ON_BOOT
	bool "Clear BLE bonding data on startup"
	default n
	help
		If enabled, clears all stored BLE bonding keys on every boot, forcing fresh pairing.
		Only enable this temporarily to resolve persistent connection issues.
		Normal operation should keep this disabled to allow reconnection.

config M4G_STACK_WATERMARK_PERIOD_MS
	int "Stack watermark log period (ms)"
	range 0 600000
	default 30000
	help
		Period for logging stack high-water marks. 0 disables periodic logging.
		Useful for debugging memory usage and preventing stack overflows.

config M4G_STACK_WATERMARK_MAX_TASKS
	int "Max tasks tracked for stack watermark"
	range 4 64
	default 24
	help
		Maximum number of tasks whose high-water marks are sampled (static array size).

config M4G_IDLE_SLEEP_TIMEOUT_MS
	int "Idle light-sleep timeout (ms)"
	range 0 3600000
	default 60000
	help
		If >0, when there is no BLE connection and no USB HID devices for this duration, the
		system will enter light sleep to save power until a wake source triggers.
		Set to 0 to disable automatic sleep.

config M4G_ENABLE_DIAG_GATT
	bool "Enable diagnostic GATT characteristic"
	default y
	help
		Adds a diagnostic characteristic that returns a system status snapshot when read.
		Useful for remote debugging and monitoring.

config M4G_DIAG_TASK_STACK_SIZE
	int "Diagnostics task stack size (bytes)"
	depends on M4G_ENABLE_DIAG_GATT
	range 1024 8192
	default 4096
	help
		Stack size for the optional diagnostics periodic task (m4g_diag). Increase if you
		see stack overflow logs referencing the m4g_diag task.
		Only applies when diagnostic GATT characteristic is enabled.

menu "Board Configuration"
	depends on M4G_TARGET_ESP32S3
	comment "Board selection sets GPIO defaults for LEDs and USB"

choice M4G_BOARD_SELECT
	prompt "Target board"
	default M4G_BOARD_DEVKIT
	help
		Select the ESP32-S3 hardware variant to apply sensible defaults for GPIOs.
		This primarily affects LED pin assignments and power control.

config M4G_BOARD_DEVKIT
	bool "ESP32-S3 DevKit"
	help
		Standard ESP32-S3 development board with full GPIO access.
		NeoPixel LED on GPIO 48 (typical for DevKitC).

config M4G_BOARD_QTPY
	bool "Adafruit QT Py ESP32-S3"
	help
		Compact Adafruit QT Py board with ESP32-S3.
		NeoPixel LED on GPIO 38, limited GPIO availability.

endchoice

choice M4G_LED_TYPE
	prompt "LED type"
	default M4G_LED_TYPE_NEOPIXEL if M4G_BOARD_DEVKIT
	default M4G_LED_TYPE_NEOPIXEL if M4G_BOARD_QTPY
	help
		Select style of status LED.
	config M4G_LED_TYPE_NONE
		bool "None"
	config M4G_LED_TYPE_SIMPLE
		bool "Simple GPIO (future)"
	config M4G_LED_TYPE_NEOPIXEL
		bool "NeoPixel / WS2812"
endchoice

config M4G_LED_DATA_GPIO
	int "LED data GPIO"
	depends on !M4G_LED_TYPE_NONE
	default 48 if M4G_BOARD_DEVKIT
	default 38 if M4G_BOARD_QTPY
	range 0 48
	help
		GPIO output driving the status LED (NeoPixel or single LED).

config M4G_LED_POWER_GPIO
	int "LED power enable GPIO (-1 to disable)"
	depends on !M4G_LED_TYPE_NONE
	default -1 if M4G_BOARD_DEVKIT
	default -1 if M4G_BOARD_QTPY
	default -1
	range -1 48
	help
		Optional power/enable pin for LED. Set -1 if not used.

config M4G_VBUS_ENABLE_GPIO
	int "VBUS enable GPIO (-1 if none)"
	default -1
	range -1 48
	help
		Optional GPIO controlling a load switch to source 5V for USB host. -1 disables.

endmenu  # Board Configuration

menu "Advanced Configuration"

config M4G_LOG_BUFFER_SIZE
	int "In-RAM log staging buffer size (bytes)"
	depends on M4G_LOG_PERSISTENCE
	range 256 4096
	default 1024
	help
		Size of the RAM buffer used to stage log lines before flushing to NVS.

config M4G_LOG_FLUSH_THRESHOLD
	int "Flush threshold (bytes)"
	depends on M4G_LOG_PERSISTENCE
	range 64 4096
	default 512
	help
		When the staging buffer reaches this many bytes, it will be flushed to NVS.

config M4G_USB_ENUMERATION_TIMEOUT_MS
	int "USB enumeration timeout (ms)"
	range 500 5000
	default 1000
	help
		Timeout for USB device enumeration. Increase for problematic devices or hubs.
		CharaChorder dual-half keyboards may need longer timeout.

config M4G_USB_POLL_PERIOD_MS
	int "USB host polling period (ms)"
	range 10 500
	default 100
	help
		Period for USB host library event processing. Lower values provide better
		responsiveness but consume more CPU. 100ms is a good balance.

config M4G_USB_DEBOUNCE_DELAY_MS
	int "USB device debounce delay (ms)"
	range 10 200
	default 50
	help
		Delay after USB device detection before attempting enumeration.
		Helps with device stability during connection.

config M4G_USB_CHARACHORDER_VENDOR_ID
	hex "CharaChorder HID vendor ID"
	default 0x303A
	help
		USB vendor ID used by CharaChorder halves. When combined with detection of the
		built-in hub, this enables the bridge to require both halves before reporting
		the USB side as connected. Set to 0 to disable automatic detection.

config M4G_USB_CHARACHORDER_PRODUCT_ID
	hex "CharaChorder HID product ID"
	default 0xFFFF
	help
		USB product ID used by CharaChorder halves. Set to 0xFFFF to treat the product
		ID as a wildcard (any product belonging to the specified vendor).

config M4G_BLE_DEVICE_NAME
	string "BLE device name"
	default "M4G-BLE-Bridge"
	help
		Name advertised by the BLE bridge. This name will appear when scanning
		for Bluetooth devices on the host computer.

config M4G_BLE_MANUFACTURER_NAME
	string "BLE manufacturer name"
	default "M4G Bridge"
	help
		Manufacturer name reported in BLE device information service.

config M4G_BLE_CONN_INTERVAL_MIN_MS
	int "BLE connection interval minimum (ms)"
	range 7 4000
	default 20
	help
		Minimum BLE connection interval in milliseconds. Lower values provide
		better latency but consume more power. 20ms is optimal for HID devices.

config M4G_BLE_CONN_INTERVAL_MAX_MS
	int "BLE connection interval maximum (ms)"
	range 7 4000
	default 40
	help
		Maximum BLE connection interval in milliseconds. Should be >= minimum.
		40ms provides good balance of latency and power consumption.

config M4G_MAIN_TASK_STACK_SIZE
	int "Main task stack size (bytes)"
	range 8192 32768
	default 16384
	help
		Stack size for the main application task. Should be sufficient for USB enumeration
		complexity and BLE stack operations. 16384 is recommended for USB host functionality.

endmenu  # Advanced Configuration

endmenu  # M4G Bridge Options
```
