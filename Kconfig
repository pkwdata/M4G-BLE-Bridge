## sdkconfig.defaults.left
```kconfig
# Split Keyboard Configuration - LEFT SIDE
# This board receives from both local USB (left keyboard) and ESP-NOW (right keyboard)
# and transmits combined output via Bluetooth

# Split keyboard role (explicit choice selection)
CONFIG_M4G_SPLIT_ROLE_LEFT=y
# CONFIG_M4G_SPLIT_ROLE_RIGHT is not set
# CONFIG_M4G_SPLIT_ROLE_STANDALONE is not set

# Bluetooth MUST be enabled for LEFT side (transmits to computer)
CONFIG_BT_ENABLED=y
CONFIG_BT_NIMBLE_ENABLED=y

# ESP-NOW settings
CONFIG_M4G_ESPNOW_CHANNEL=1
# CONFIG_M4G_ESPNOW_USE_ENCRYPTION is not set
CONFIG_M4G_ESPNOW_PMK="M4G_SPLIT_KEY!!"

# Use GPIO UART for console output (for FTDI debugging)
# QtPy ESP32-S3: TX=GPIO17, RX=GPIO18
CONFIG_ESP_CONSOLE_UART=y
# CONFIG_ESP_CONSOLE_USB_CDC is not set
# CONFIG_ESP_CONSOLE_USB_SERIAL_JTAG is not set
CONFIG_ESP_CONSOLE_UART_NUM=0
CONFIG_ESP_CONSOLE_UART_TX_GPIO=17
CONFIG_ESP_CONSOLE_UART_RX_GPIO=18
CONFIG_ESP_CONSOLE_UART_BAUDRATE=115200
CONFIG_ESP_CONSOLE_SECONDARY_NONE=y
```

## sdkconfig.defaults.right
```kconfig
# Split Keyboard Configuration - RIGHT SIDE
# This board receives from local USB (right keyboard) and transmits via ESP-NOW to left side
# No Bluetooth functionality on this board

# Split keyboard role (explicit choice selection)
# CONFIG_M4G_SPLIT_ROLE_LEFT is not set
CONFIG_M4G_SPLIT_ROLE_RIGHT=y
# CONFIG_M4G_SPLIT_ROLE_STANDALONE is not set

# ESP-NOW settings
CONFIG_M4G_ESPNOW_CHANNEL=1
# CONFIG_M4G_ESPNOW_USE_ENCRYPTION is not set
CONFIG_M4G_ESPNOW_PMK="M4G_SPLIT_KEY!!"

# Disable BLE to save memory (right side doesn't need it)
CONFIG_BT_ENABLED=n

# Use GPIO UART for console output (for FTDI debugging)
# NOTE: UART pins are board-specific. Adjust for your hardware:
#   - QT Py ESP32-S3: TX=GPIO17, RX=GPIO18
#   - DevKit-1: TX=GPIO43, RX=GPIO44 (standard UART0)
CONFIG_ESP_CONSOLE_UART=y
# CONFIG_ESP_CONSOLE_USB_CDC is not set
# CONFIG_ESP_CONSOLE_USB_SERIAL_JTAG is not set
CONFIG_ESP_CONSOLE_UART_NUM=0
CONFIG_ESP_CONSOLE_UART_TX_GPIO=43
CONFIG_ESP_CONSOLE_UART_RX_GPIO=44
CONFIG_ESP_CONSOLE_UART_BAUDRATE=115200
CONFIG_ESP_CONSOLE_SECONDARY_NONE=y

# LED auto-detection is enabled by default
# The firmware will automatically detect:
#   - QT Py: GPIO39 (data) + GPIO38 (power)
#   - DevKit-1: GPIO48 (data only)
```

## sdkconfig.defaults.standalone
```kconfig
# Standalone Keyboard Configuration
# This is the original single keyboard mode (no split keyboard features)
# Connects to one keyboard via USB and transmits to computer via Bluetooth

# Split keyboard role (explicit choice selection)
# CONFIG_M4G_SPLIT_ROLE_LEFT is not set
# CONFIG_M4G_SPLIT_ROLE_RIGHT is not set
CONFIG_M4G_SPLIT_ROLE_STANDALONE=y

# Bluetooth MUST be enabled for STANDALONE (transmits to computer)
CONFIG_BT_ENABLED=y
CONFIG_BT_NIMBLE_ENABLED=y

# ESP-NOW not used in standalone mode (optional - will be compiled but unused)
```
