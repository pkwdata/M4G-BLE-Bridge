## Kconfig.projbuild
```kconfig
# Kconfig.projbuild for M4G Bridge project options.
# Added a top-level 'menuconfig M4G_BRIDGE_FEATURES' anchor so the
# menu reliably appears even if plain 'menu' ordering changes.

menuconfig M4G_BRIDGE_FEATURES
    bool "M4G Bridge Options"
    default y
    help
        Master toggle / anchor for all custom M4G project options.
        Disable to hide all M4G-related configuration entries.

if M4G_BRIDGE_FEATURES

menu "Feature Settings"

config M4G_ENABLE_ARROW_MOUSE
    bool "Enable arrow keys -> mouse movement mapping"
    default y
    help
        When enabled, the bridge will translate arrow keys into relative mouse
        movements. Disable to pass arrow keys through unchanged.

config M4G_ENABLE_DUPLICATE_SUPPRESSION
    bool "Suppress duplicate consecutive HID reports"
    default y
    help
        When enabled, identical consecutive keyboard/mouse reports will not be
        re-sent over BLE to reduce bandwidth and power.

config M4G_LOG_PERSISTENCE
    bool "Persist logs to NVS"
    default y if M4G_BOARD_QTPY
    default n if M4G_BOARD_DEVKIT
    help
        Controls whether logs are appended to an NVS blob for retrieval on next boot.
        Default: enabled for QT Py board, disabled for DevKit.

config M4G_LOG_BUFFER_SIZE
    int "In-RAM log staging buffer size (bytes)"
    depends on M4G_LOG_PERSISTENCE
    range 256 4096
    default 1024
    help
        Size of the RAM buffer used to stage log lines before flushing to NVS.

config M4G_LOG_FLUSH_THRESHOLD
    int "Flush threshold (bytes)"
    depends on M4G_LOG_PERSISTENCE
    range 64 4096
    default 512
    help
        When the staging buffer reaches this many bytes, it will be flushed to NVS.

config M4G_ASSERT_BLE_HANDLE
    bool "Assert BLE report handle resolved"
    default y
    help
        If enabled, sending a report before the characteristic handle is resolved
        triggers an assert (development aid).

config M4G_STACK_WATERMARK_PERIOD_MS
    int "Stack watermark log period (ms)"
    range 0 600000
    default 30000
    help
        Period for logging stack high-water marks. 0 disables periodic logging.

config M4G_STACK_WATERMARK_MAX_TASKS
    int "Max tasks tracked for stack watermark"
    range 4 64
    default 24
    help
        Maximum number of tasks whose high-water marks are sampled (static array size).

config M4G_IDLE_SLEEP_TIMEOUT_MS
    int "Idle light-sleep timeout (ms)"
    range 0 3600000
    default 60000
    help
        If >0, when there is no BLE connection and no USB HID devices for this duration, the
        system will enter light sleep to save power until a wake source triggers.

config M4G_ENABLE_DIAG_GATT
    bool "Enable diagnostic GATT characteristic"
    default y
    help
        Adds a diagnostic characteristic that returns a status snapshot when read.

config M4G_DIAG_TASK_STACK_SIZE
    int "Diagnostics task stack size (bytes)"
    range 1024 8192
    default 4096
    help
        Stack size for the optional diagnostics periodic task (m4g_diag). Increase if you
        see stack overflow logs referencing the m4g_diag task.

menu "Board Configuration"

choice M4G_BOARD_SELECT
    prompt "Target board"
    default M4G_BOARD_DEVKIT
    help
        Select the hardware variant to apply sensible defaults for GPIOs.

config M4G_BOARD_DEVKIT
    bool "ESP32-S3 DevKit"

config M4G_BOARD_QTPY
    bool "Adafruit QT Py ESP32-S3"

endchoice

choice M4G_LED_TYPE
    prompt "LED type"
    default M4G_LED_TYPE_NEOPIXEL if M4G_BOARD_DEVKIT
    default M4G_LED_TYPE_NEOPIXEL if M4G_BOARD_QTPY
    help
        Select style of status LED.
    config M4G_LED_TYPE_NONE
        bool "None"
    config M4G_LED_TYPE_SIMPLE
        bool "Simple GPIO (future)"
    config M4G_LED_TYPE_NEOPIXEL
        bool "NeoPixel / WS2812"
endchoice

config M4G_LED_DATA_GPIO
    int "LED data GPIO"
    default 48 if M4G_BOARD_DEVKIT
    default 38 if M4G_BOARD_QTPY
    range 0 48
    help
        GPIO output driving the status LED (NeoPixel or single LED).

config M4G_LED_POWER_GPIO
    int "LED power enable GPIO (-1 to disable)"
    default -1 if M4G_BOARD_DEVKIT
    default -1 if M4G_BOARD_QTPY
    default -1
    range -1 48
    help
        Optional power/enable pin for LED. Set -1 if not used.

config M4G_VBUS_ENABLE_GPIO
    int "VBUS enable GPIO (-1 if none)"
    default -1
    range -1 48
    help
        Optional GPIO controlling a load switch to source 5V for USB host. -1 disables.

endmenu  # Feature Settings

endmenu  # M4G Bridge Options (menuconfig)

endif # M4G_BRIDGE_FEATURES
```

## components/m4g_settings/Kconfig
```kconfig
menu "M4G Settings Configuration"

    config M4G_SETTINGS_ENABLE_NVS_PERSISTENCE
        bool "Enable NVS persistence for runtime settings"
        default y
        help
            When enabled, settings can be modified at runtime and saved to NVS.
            Persisted settings survive reboots. When disabled, only compile-time
            Kconfig defaults are used.

    menu "Chord Detection Settings"

        config M4G_CHORD_DELAY_MS_DEFAULT
            int "CharaChorder output detection delay (ms)"
            default 15
            range 10 50
            help
                Time to wait for CharaChorder firmware to send chord output after key release.
                CharaChorder uses ~10-25ms for output generation. Setting this too low may
                cause chords to be sent as individual keys; too high adds perceptible latency.
                
                Based on CharaChorder DeviceManager analysis:
                - 15ms: Fast response, reliable for most users
                - 25ms: More tolerance for slower CharaChorder firmware
                
                This is the DEFAULT value. Can be changed at runtime if NVS persistence enabled.

        config M4G_CHORD_TIMEOUT_MS_DEFAULT
            int "Single-key chord timeout (ms)"
            default 500
            range 100 2000
            help
                Time to wait before emitting a single held key to enable key repeat.
                If a single key is held in the chord buffer for this duration without
                release or additional keys, it will be emitted to allow OS/firmware repeat.
                
                Based on CharaChorder DeviceManager analysis:
                - 500ms: Good balance - allows chord detection while enabling repeat
                - 1000ms: Longer delay before repeat can start
                
                This is the DEFAULT value. Can be changed at runtime if NVS persistence enabled.

        config M4G_CHORD_PRESS_DEVIATION_MAX_MS_DEFAULT
            int "Maximum press deviation for chord detection (ms)"
            default 100
            range 20 500
            help
                Maximum time spread between first and last key press in a chord.
                CharaChorder considers <25ms * key_count as acceptable quality.
                
                For 4-key chords: 100ms is the upper acceptable limit.
                For perfect quality: 40ms (10ms * 4 keys)
                
                This is the DEFAULT value. Can be changed at runtime if NVS persistence enabled.

        config M4G_CHORD_RELEASE_DEVIATION_MAX_MS_DEFAULT
            int "Maximum release deviation for chord detection (ms)"
            default 72
            range 20 300
            help
                Maximum time spread between first and last key release in a chord.
                CharaChorder considers <18ms * key_count as acceptable quality.
                
                For 4-key chords: 72ms is the upper acceptable limit.
                For perfect quality: 40ms (10ms * 4 keys)
                
                This is the DEFAULT value. Can be changed at runtime if NVS persistence enabled.

    endmenu

    menu "Key Repeat Settings"

        config M4G_ENABLE_KEY_REPEAT
            bool "Enable key repeat functionality"
            default y
            help
                Enable key repeat for held keys. When a single key is held for longer
                than the chord timeout (500ms), it will be emitted and repeat will start.
                
                This is the DEFAULT value. Can be changed at runtime if NVS persistence enabled.

        config M4G_KEY_REPEAT_DELAY_MS_DEFAULT
            int "Key repeat initial delay (ms)"
            default 1000
            range 250 2000
            help
                Time a key must be held before repeating starts.
                Standard OS default is 1000ms (Windows/Linux).
                
                This is the DEFAULT value. Can be changed at runtime if NVS persistence enabled.

        config M4G_KEY_REPEAT_RATE_MS_DEFAULT
            int "Key repeat rate (ms between repeats)"
            default 33
            range 16 200
            help
                Time between repeated key events once repeat has started.
                
                Common values:
                - 33ms: ~30 Hz (Windows default)
                - 50ms: ~20 Hz (slower repeat)
                - 16ms: ~60 Hz (very fast)
                
                This is the DEFAULT value. Can be changed at runtime if NVS persistence enabled.

    endmenu

    menu "Feature Toggles"

        config M4G_RAW_MODE_DEFAULT
            bool "CharaChorder raw mode (disable chord processing)"
            default n
            help
                When enabled, all chord detection is bypassed and keys are passed
                through directly. This was causing issues when accidentally enabled.
                
                Only enable for debugging or if using CharaChorder as a regular keyboard.
                
                This is the DEFAULT value. Can be changed at runtime if NVS persistence enabled.

        config M4G_DUPLICATE_SUPPRESSION_DEFAULT
            bool "Enable duplicate report suppression"
            default y
            help
                Suppress sending identical consecutive HID reports.
                Reduces BLE bandwidth and improves battery life.
                
                This is the DEFAULT value. Can be changed at runtime if NVS persistence enabled.

        config M4G_CHORD_DEVIATION_TRACKING_DEFAULT
            bool "Enable chord quality deviation tracking"
            default n
            help
                Track and log chord quality metrics (press/release deviation).
                Useful for diagnostics and tuning chord detection parameters.
                
                Based on CharaChorder DeviceManager analysis:
                - Press deviation: time spread of key presses
                - Release deviation: time spread of key releases
                
                Adds logging overhead but provides valuable quality metrics.
                
                This is the DEFAULT value. Can be changed at runtime if NVS persistence enabled.

    endmenu

    config M4G_SETTINGS_RESET_ON_BOOT
        bool "Reset settings to defaults on next boot"
        default n
        help
            Enable this temporarily to reset all NVS-stored settings to their
            Kconfig defaults on the next boot. Will automatically disable itself
            after reset is complete.
            
            Use this if settings become corrupted or you want to start fresh.

endmenu
```

## sdkconfig.defaults
```kconfig
# ESP32-S3 Configuration
CONFIG_IDF_TARGET="esp32s3"

# CPU Configuration for better USB performance
CONFIG_ESP_DEFAULT_CPU_FREQ_MHZ_240=y
CONFIG_ESP_DEFAULT_CPU_FREQ_MHZ=240

# Bluetooth Configuration
CONFIG_BT_ENABLED=y
CONFIG_BT_NIMBLE_ENABLED=y
CONFIG_BT_NIMBLE_MAX_CONNECTIONS=1
CONFIG_BT_NIMBLE_HID_SERVICE=y
CONFIG_BT_NIMBLE_GAP_DEVICE_NAME_MAX_LEN=31
CONFIG_BT_NIMBLE_ATT_PREFERRED_MTU=128

# Disable advanced BLE features for Windows compatibility
CONFIG_BT_NIMBLE_ENABLE_CONN_REATTEMPT=n
CONFIG_BT_NIMBLE_EXT_ADV=n
CONFIG_BT_NIMBLE_50_FEATURE_SUPPORT=n
CONFIG_BT_NIMBLE_LL_CFG_FEAT_LE_2M_PHY=n
CONFIG_BT_NIMBLE_LL_CFG_FEAT_LE_CODED_PHY=n
CONFIG_BT_NIMBLE_LL_CFG_FEAT_LE_CSA2=n
CONFIG_BT_NIMBLE_LL_CFG_FEAT_DATA_LEN_EXT=n
CONFIG_BT_NIMBLE_LL_CFG_FEAT_LE_PING=n
CONFIG_BT_NIMBLE_LL_CFG_FEAT_SLAVE_INIT_FEAT_XCHG=n

# Security and Pairing Configuration for HID compatibility
CONFIG_BT_NIMBLE_SM_LEGACY=y
CONFIG_BT_NIMBLE_SM_SC=n
CONFIG_BT_NIMBLE_DEBUG=n

# Additional BLE controller level compatibility settings
CONFIG_BT_CONTROLLER_ENABLED=y
CONFIG_BT_CONTROLLER_BLE_MAX_CONN=1
CONFIG_BT_CONTROLLER_DIS_SCAN_BACKOFF=y

# Windows HID compatibility - force basic BLE mode
CONFIG_BT_NIMBLE_MAX_CONNECTIONS=1
CONFIG_BT_NIMBLE_L2CAP_COC_MAX_NUM=0
CONFIG_BT_NIMBLE_MAX_CCCDS=8

# Disable connection parameter requests that cause UNSUPP_REM_FEATURE
CONFIG_BT_NIMBLE_LL_CFG_FEAT_CONN_PARAM_REQ=n

# Disable LE Privacy features that Windows might request
CONFIG_BT_NIMBLE_LL_CFG_FEAT_LE_PRIVACY=n
CONFIG_BT_NIMBLE_PRIVACY=n

# USB Host Configuration
CONFIG_USB_HOST_ENABLE=y
CONFIG_USB_HOST_HUB_ENABLE=y
CONFIG_USB_OTG_SUPPORTED=y
CONFIG_USB_HOST_CONTROL_TRANSFER_MAX_SIZE=512
CONFIG_USB_HOST_HW_BUFFER_BIAS_BALANCED=y

# USB Host Channel Configuration - use menuconfig values
# Note: USB channel count is typically hardware-limited on ESP32-S3
# The DWC2 controller has a fixed number of channels (usually 8 total)

# Optimize USB resource allocation instead
CONFIG_USB_HOST_PERIODIC_FRAME_LIST_SIZE=1024

# USB Hub Configuration (Critical for CharaChorder dual ESP32-S3 setup)
CONFIG_USB_HOST_HUB_MULTI_LEVEL=y
CONFIG_USB_HOST_HUB_ROOT_PORT_DEBOUNCE_DELAY_MS=1000
CONFIG_USB_HOST_HUB_PORT_RECOVERY_DELAY_MS=100

# USB HID Host Configuration
CONFIG_USB_HOST_HID_ENABLE=y
CONFIG_USB_HOST_HID_MAX_INTERFACES=4
CONFIG_USB_HOST_HID_MAX_DEVICES=4

# USB Enumeration Timeouts (optimized for hub + dual devices)
CONFIG_USB_HOST_DEBOUNCE_DELAY_MS=1000
CONFIG_USB_HOST_RESET_HOLD_MS=50
CONFIG_USB_HOST_RESET_RECOVERY_MS=100
CONFIG_USB_HOST_SET_ADDR_RECOVERY_MS=10

# USB Physical Layer
CONFIG_USB_OTG_SUPPORTED=y
CONFIG_USB_HOST_ENABLE_ENUM_FILTER_CALLBACK=y

# Memory Configuration (increased for multiple USB devices)
CONFIG_ESP_MAIN_TASK_STACK_SIZE=16384
CONFIG_ESP_SYSTEM_EVENT_TASK_STACK_SIZE=8192
CONFIG_ESP_INT_WDT_TIMEOUT_MS=800
CONFIG_ESP_TASK_WDT_TIMEOUT_S=10

# FreeRTOS Configuration
CONFIG_FREERTOS_HZ=1000
CONFIG_FREERTOS_ASSERT_ON_UNTESTED_FUNCTION=y

# Log Configuration (comprehensive USB debugging)
CONFIG_LOG_DEFAULT_LEVEL_INFO=y
CONFIG_LOG_MAXIMUM_LEVEL_DEBUG=y
CONFIG_LOG_COLORS=y

# USB-specific logging for debugging enumeration issues
CONFIG_USB_HOST_LOG_LEVEL_DEBUG=y
CONFIG_HUB_LOG_LEVEL_DEBUG=y
CONFIG_ENUM_LOG_LEVEL_DEBUG=y
CONFIG_USB_HOST_HID_LOG_LEVEL_DEBUG=y

# BLE-specific logging for debugging connection issues
CONFIG_BT_LOG_LEVEL_DEBUG=y
CONFIG_BT_NIMBLE_LOG_LEVEL_DEBUG=y

# Power Management (optimized for USB stability)
CONFIG_PM_ENABLE=y
CONFIG_PM_DFS_INIT_AUTO=y
CONFIG_PM_USE_RTC_TIMER_REF=y

# Flash Configuration
CONFIG_ESPTOOLPY_FLASHSIZE_4MB=y
CONFIG_ESPTOOLPY_FLASHMODE_DIO=y
CONFIG_ESPTOOLPY_FLASHFREQ_80M=y

# Compiler Optimizations
CONFIG_COMPILER_OPTIMIZATION_SIZE=y
CONFIG_COMPILER_OPTIMIZATION_ASSERTIONS_ENABLE=y
```
